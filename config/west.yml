## config/west.yml
```yaml
manifest:
  remotes:
    - name: zmkfirmware
      url-base: https://github.com/zmkfirmware
    - name: infused-kim
      url-base: https://github.com/infused-kim
    - name: kuolemax
      url-base: https://github.com/kuolemax
    - name: mozixun
      url-base: https://github.com/mozixun-me
  projects:
    - name: zmk
      remote: zmkfirmware
      revision: main
      # remote: kuolemax
      # revision: bongo-cat
      # remote: mozixun
      # revision: main
      import: app/west.yml
  self:
    path: config
```
